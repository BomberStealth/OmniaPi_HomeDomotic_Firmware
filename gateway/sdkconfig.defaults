## gateway/sdkconfig.defaults
```kconfig
# OmniaPi Gateway - ESP-IDF Configuration

# ============== WiFi ==============
CONFIG_ESP_WIFI_SSID="Porte Di Durin"
CONFIG_ESP_WIFI_PASSWORD="Mellon!!!"
CONFIG_ESP_MAXIMUM_RETRY=10

# ============== ESP-NOW ==============
CONFIG_ESP_NOW_ENABLE=y

# ============== MQTT ==============
CONFIG_MQTT_BROKER_URL="mqtt://192.168.1.252:1883"

# ============== HTTP Server ==============
CONFIG_HTTPD_MAX_REQ_HDR_LEN=1024
CONFIG_HTTPD_MAX_URI_LEN=512

# ============== SPIFFS ==============
CONFIG_SPIFFS_MAX_PARTITIONS=3

# ============== Flash Size ==============
CONFIG_ESPTOOLPY_FLASHSIZE_4MB=y
CONFIG_ESPTOOLPY_FLASHSIZE="4MB"

# ============== Partition Table ==============
CONFIG_PARTITION_TABLE_CUSTOM=y
CONFIG_PARTITION_TABLE_CUSTOM_FILENAME="partitions.csv"

# ============== Log Level ==============
CONFIG_LOG_DEFAULT_LEVEL_INFO=y
CONFIG_LOG_MAXIMUM_LEVEL_DEBUG=y

# ============== FreeRTOS ==============
CONFIG_FREERTOS_HZ=1000

# ============== ESP32 Specific ==============
CONFIG_ESP32_WIFI_STATIC_RX_BUFFER_NUM=10
CONFIG_ESP32_WIFI_DYNAMIC_RX_BUFFER_NUM=32
CONFIG_ESP32_WIFI_TX_BUFFER_TYPE=1
CONFIG_ESP32_WIFI_DYNAMIC_TX_BUFFER_NUM=32

# ============== Watchdog ==============
CONFIG_ESP_TASK_WDT_TIMEOUT_S=10
```

## gateway_mesh/main/Kconfig.projbuild
```kconfig
menu "OmniaPi Gateway Mesh Configuration"

    menu "Mesh Network Settings"
        config MESH_CHANNEL
            int "Mesh network channel"
            range 1 14
            default 6
            help
                WiFi channel for mesh network (1-14).

        config MESH_ROUTER_SSID
            string "Router SSID"
            default ""
            help
                SSID of the router to connect to (for internet access).
                Leave empty for provisioning via API.

        config MESH_ROUTER_PASSWD
            string "Router Password"
            default ""
            help
                Password of the router.
                Leave empty for provisioning via API.

        config MESH_AP_PASSWD
            string "Mesh AP Password"
            default "omniapi_mesh"
            help
                Password for mesh softAP (used by child nodes to connect).

        config MESH_MAX_LAYER
            int "Maximum mesh layer"
            range 2 25
            default 6
            help
                Maximum number of layers in the mesh network (root = layer 1).

        config MESH_AP_CONNECTIONS
            int "Maximum mesh AP connections"
            range 1 10
            default 6
            help
                Maximum number of child nodes that can connect to this device.

        config MESH_NON_MESH_AP_CONNECTIONS
            int "Maximum non-mesh AP connections"
            range 0 4
            default 0
            help
                Maximum number of non-mesh stations (e.g., phones for commissioning).
    endmenu

    menu "MQTT Settings"
        config MQTT_BROKER_URI
            string "MQTT Broker URI"
            default "mqtt://192.168.1.252:1883"
            help
                URI of the MQTT broker (e.g., mqtt://host:port).
                Leave empty for provisioning via API.

        config MQTT_USERNAME
            string "MQTT Username"
            default ""
            help
                MQTT broker username.

        config MQTT_PASSWORD
            string "MQTT Password"
            default ""
            help
                MQTT broker password.

        config MQTT_CLIENT_ID
            string "MQTT Client ID"
            default "omniapi_gateway"
            help
                MQTT client identifier.
    endmenu

    menu "Ethernet Settings (WT32-ETH01)"
        config ETH_PHY_ADDR
            int "PHY Address"
            range 0 31
            default 1
            help
                PHY address for LAN8720 on WT32-ETH01.

        config ETH_PHY_RST_GPIO
            int "PHY Reset GPIO"
            range -1 39
            default -1
            help
                GPIO for PHY reset (-1 = not used).

        config ETH_MDC_GPIO
            int "MDC GPIO"
            default 23
            help
                GPIO for RMII MDC.

        config ETH_MDIO_GPIO
            int "MDIO GPIO"
            default 18
            help
                GPIO for RMII MDIO.

        config ETH_CLK_MODE
            int "Clock Mode"
            range 0 3
            default 0
            help
                0=GPIO0_IN, 1=GPIO0_OUT, 2=GPIO16_OUT, 3=GPIO17_OUT
    endmenu

    menu "Status LED"
        config STATUS_LED_GPIO
            int "Status LED GPIO"
            range -1 39
            default 2
            help
                GPIO pin for status LED (-1 = disabled).
                WT32-ETH01 typically has LED on GPIO 2.

        config STATUS_LED_ACTIVE_LOW
            bool "LED active low"
            default n
            help
                If enabled, LED is ON when GPIO is LOW.
    endmenu

    menu "Gateway Settings"
        config GATEWAY_FIRMWARE_VERSION
            string "Firmware Version"
            default "1.3.5"
            help
                Gateway firmware version string.

        config GATEWAY_HEARTBEAT_INTERVAL_MS
            int "Heartbeat interval (ms)"
            range 1000 60000
            default 5000
            help
                Interval for sending heartbeat to nodes.

        config GATEWAY_NODE_TIMEOUT_MS
            int "Node timeout (ms)"
            range 10000 300000
            default 30000
            help
                Time after which a node is considered offline.
    endmenu

endmenu
```

## gateway_mesh/sdkconfig.defaults
```kconfig
# OmniaPi Gateway Mesh - Default Configuration
# Target: ESP32 (WT32-ETH01)

# ==================== Target ====================
CONFIG_IDF_TARGET="esp32"

# ==================== Partition Table ====================
CONFIG_PARTITION_TABLE_CUSTOM=y
CONFIG_PARTITION_TABLE_CUSTOM_FILENAME="partitions.csv"
CONFIG_PARTITION_TABLE_FILENAME="partitions.csv"

# ==================== Flash Size ====================
CONFIG_ESPTOOLPY_FLASHSIZE_4MB=y
CONFIG_ESPTOOLPY_FLASHSIZE="4MB"

# ==================== WiFi & Mesh ====================
CONFIG_ESP_WIFI_SOFTAP_SUPPORT=y
CONFIG_ESP_WIFI_NVS_ENABLED=y

# Router Configuration (for Internet access)
# Empty by default - provision via API
CONFIG_MESH_ROUTER_SSID=""
CONFIG_MESH_ROUTER_PASSWD=""

# Mesh Configuration
CONFIG_MESH_CHANNEL=0
CONFIG_MESH_AP_PASSWD="omniapi_mesh_2024"
CONFIG_MESH_MAX_LAYER=6
CONFIG_MESH_AP_CONNECTIONS=6
CONFIG_MESH_NON_MESH_AP_CONNECTIONS=0
CONFIG_MESH_ROUTE_TABLE_SIZE=50

# ==================== Ethernet (WT32-ETH01 / LAN8720) ====================
CONFIG_ETH_USE_ESP32_EMAC=y
CONFIG_ETH_PHY_INTERFACE_RMII=y
CONFIG_ETH_RMII_CLK_INPUT=y
CONFIG_ETH_RMII_CLK_IN_GPIO=0

# LAN8720 PHY
CONFIG_ETH_PHY_ADDR=1
CONFIG_ETH_MDC_GPIO=23
CONFIG_ETH_MDIO_GPIO=18
CONFIG_ETH_PHY_RST_GPIO=-1

# ==================== LWIP ====================
CONFIG_LWIP_LOCAL_HOSTNAME="omniapi-gateway"
CONFIG_LWIP_IP4_NAPT=y
CONFIG_LWIP_DNS_SUPPORT_MDNS_QUERIES=y
CONFIG_LWIP_MAX_SOCKETS=16

# ==================== MQTT ====================
# Empty by default - provision via API
CONFIG_MQTT_BROKER_URI=""
CONFIG_MQTT_PROTOCOL_311=y
CONFIG_MQTT_TRANSPORT_SSL=n
CONFIG_MQTT_TRANSPORT_WEBSOCKET=n

# ==================== NVS ====================
CONFIG_NVS_ENCRYPTION=n

# ==================== OTA ====================
CONFIG_BOOTLOADER_APP_ROLLBACK_ENABLE=y
CONFIG_APP_ROLLBACK_ENABLE=y

# ==================== FreeRTOS ====================
CONFIG_FREERTOS_HZ=1000
CONFIG_FREERTOS_USE_TRACE_FACILITY=y
CONFIG_FREERTOS_USE_STATS_FORMATTING_FUNCTIONS=y

# ==================== Logging ====================
CONFIG_LOG_DEFAULT_LEVEL_INFO=y
CONFIG_LOG_MAXIMUM_LEVEL_DEBUG=y

# ==================== Watchdog ====================
CONFIG_ESP_TASK_WDT_TIMEOUT_S=30
CONFIG_ESP_TASK_WDT_PANIC=n

# ==================== Power Management ====================
CONFIG_PM_ENABLE=n

# ==================== Brownout Detector ====================
# Disabled for WT32-ETH01 (WiFi radio triggers false brownouts)
CONFIG_ESP_BROWNOUT_DET=n

# ==================== Memory ====================
CONFIG_ESP32_SPIRAM_SUPPORT=n

# ==================== Compiler ====================
CONFIG_COMPILER_OPTIMIZATION_SIZE=y

# ==================== Serial Output ====================
CONFIG_ESP_CONSOLE_UART_DEFAULT=y
CONFIG_ESP_CONSOLE_UART_NUM=0
CONFIG_ESP_CONSOLE_UART_BAUDRATE=115200

# ==================== HTTP Server (Web UI) ====================
CONFIG_HTTPD_MAX_REQ_HDR_LEN=1024
CONFIG_HTTPD_MAX_URI_LEN=512
CONFIG_HTTPD_WS_SUPPORT=y
CONFIG_HTTPD_QUEUE_WORK_BLOCKING_TIMEOUT=500

# ==================== Status LED ====================
# Disabled on WT32-ETH01 (GPIO 2 may conflict)
CONFIG_STATUS_LED_GPIO=-1
```

## led_strip/sdkconfig.defaults
```kconfig
# ESP32-S2 Mini configuration
CONFIG_IDF_TARGET="esp32s2"

# Flash size 4MB (ESP32-S2 Mini)
CONFIG_ESPTOOLPY_FLASHSIZE_4MB=y

# Console via USB CDC (ESP32-S2 native USB)
CONFIG_ESP_CONSOLE_USB_CDC=y
CONFIG_ESP_CONSOLE_SECONDARY_NONE=y

# FreeRTOS tick rate
CONFIG_FREERTOS_HZ=1000

# Disable SoftAP (not needed)
CONFIG_ESP_WIFI_SOFTAP_SUPPORT=n

# Custom partition table for OTA support
CONFIG_PARTITION_TABLE_CUSTOM=y
CONFIG_PARTITION_TABLE_CUSTOM_FILENAME="partitions.csv"
CONFIG_PARTITION_TABLE_FILENAME="partitions.csv"

# RMT for LED strip (WS2812B)
CONFIG_RMT_ISR_IRAM_SAFE=y
```

## node/sdkconfig.defaults
```kconfig
CONFIG_ESP_CONSOLE_NONE=y
CONFIG_ESP_CONSOLE_USB_SERIAL_JTAG=n
CONFIG_ESP_WIFI_SOFTAP_SUPPORT=n
CONFIG_FREERTOS_HZ=1000

# Custom partition table for OTA support
CONFIG_PARTITION_TABLE_CUSTOM=y
CONFIG_PARTITION_TABLE_CUSTOM_FILENAME="partitions.csv"
CONFIG_PARTITION_TABLE_FILENAME="partitions.csv"
```

## node_mesh/main/Kconfig.projbuild
```kconfig
menu "OmniaPi Node Mesh Configuration"

    menu "Mesh Network Settings"
        config MESH_ROUTER_SSID
            string "Router SSID"
            default "Porte Di Durin"
            help
                Router SSID (required by ESP-MESH even for non-root nodes).

        config MESH_ROUTER_PASSWD
            string "Router Password"
            default "Mellon!!!"
            help
                Router password (required by ESP-MESH even for non-root nodes).

        config MESH_CHANNEL
            int "Mesh network channel"
            range 0 14
            default 0
            help
                WiFi channel for mesh network (0 = auto, must match gateway).

        config MESH_AP_PASSWD
            string "Mesh AP Password"
            default "omniapi_mesh_2024"
            help
                Password for mesh network (must match gateway).

        config MESH_MAX_LAYER
            int "Maximum mesh layer"
            range 2 25
            default 6
            help
                Maximum number of layers in the mesh network.

        config MESH_AP_CONNECTIONS
            int "Maximum mesh AP connections"
            range 1 10
            default 6
            help
                Maximum number of child nodes that can connect to this node.
    endmenu

    menu "Device Type"
        choice NODE_DEVICE_TYPE
            prompt "Node device type"
            default NODE_DEVICE_TYPE_RELAY
            help
                Select the type of device this node controls.

            config NODE_DEVICE_TYPE_RELAY
                bool "Relay module"

            config NODE_DEVICE_TYPE_LED
                bool "LED strip (WS2812B)"

            config NODE_DEVICE_TYPE_SENSOR
                bool "Sensor only"
        endchoice
    endmenu

    menu "Relay Configuration"
        depends on NODE_DEVICE_TYPE_RELAY

        comment "Relay mode (GPIO/UART) is configurable at runtime via gateway UI"

        config RELAY_COUNT
            int "Number of relay channels"
            range 1 4
            default 1
            help
                Number of relay channels on this module.

        menu "GPIO Mode Settings"
            config RELAY_CH1_GPIO
                int "Relay Channel 1 GPIO (for GPIO mode)"
                range 0 21
                default 2
                help
                    GPIO pin for relay channel 1 when using GPIO mode.

            config RELAY_ACTIVE_HIGH
                bool "Relay active high"
                default y
                help
                    If enabled, relay is ON when GPIO is HIGH.
        endmenu

        menu "UART Mode Settings"
            config RELAY_UART_TX_GPIO
                int "UART TX GPIO (for UART mode)"
                range 0 21
                default 21
                help
                    GPIO pin for UART TX (connects to relay module RX pin).

            config RELAY_UART_BAUD
                int "UART Baud rate"
                default 9600
                help
                    Baud rate for relay UART communication.
        endmenu
    endmenu

    menu "LED Strip Configuration"
        depends on NODE_DEVICE_TYPE_LED

        config LED_STRIP_GPIO
            int "LED Strip data GPIO"
            range 0 21
            default 8
            help
                GPIO pin for WS2812B data line.

        config LED_STRIP_COUNT
            int "Number of LEDs"
            range 1 300
            default 30
            help
                Number of LEDs in the strip.

        config LED_STRIP_RMT_CHANNEL
            int "RMT Channel"
            range 0 3
            default 0
            help
                RMT channel for LED control.
    endmenu

    menu "Button Configuration"
        config BUTTON_GPIO
            int "Button GPIO"
            range 0 21
            default 9
            help
                GPIO pin for the physical button.

        config BUTTON_ACTIVE_LOW
            bool "Button active low"
            default y
            help
                If enabled, button is pressed when GPIO is LOW.

        config BUTTON_LONG_PRESS_MS
            int "Long press duration (ms)"
            range 1000 30000
            default 10000
            help
                Duration to trigger factory reset (10 seconds default).
    endmenu

    menu "Status LED"
        config STATUS_LED_GPIO
            int "Status LED GPIO"
            range -1 21
            default 10
            help
                GPIO pin for status LED (-1 = disabled).
                ESP32-C3: GPIO 10 is typically free.

        config STATUS_LED_ACTIVE_LOW
            bool "LED active low"
            default n
            help
                If enabled, LED is ON when GPIO is LOW.
    endmenu

    menu "Node Settings"
        config NODE_FIRMWARE_VERSION
            string "Firmware Version"
            default "1.1.2"
            help
                Node firmware version string.

        config NODE_HEARTBEAT_RESPONSE_TIMEOUT_MS
            int "Heartbeat response timeout (ms)"
            range 5000 60000
            default 15000
            help
                Time to wait for gateway heartbeat before reconnect attempt.
    endmenu

endmenu
```
